/dts-v1/;

/ {
	compatible = "brcm,bcm2835", "brcm,bcm2708", "brcm,bcm2709";

	fragment@0 {
		target = <0xffffffff>;

		__overlay__ {
			status = "okay";

			spidev@0 {
				status = "disabled";
			};

			spidev@1 {
				status = "disabled";
			};
		};
	};

	fragment@1 {
		target = <0xffffffff>;

		__overlay__ {

			waveshare35a_pins {
				brcm,pins = <0x11 0x19 0x18>;
				brcm,function = <0x0 0x0 0x0>;
				phandle = <0x1>;
			};
		};
	};

	fragment@2 {
		target = <0xffffffff>;

		__overlay__ {
			#address-cells = <0x1>;
			#size-cells = <0x0>;

			waveshare35a@0 {
				compatible = "ilitek,ili9486";
				reg = <0x0>;
				pinctrl-names = "default";
				pinctrl-0 = <0x1>;
				spi-max-frequency = <0xf42400>;
				txbuflen = <0x8000>;
				rotate = <0x5a>;
				bgr = <0x0>;
				fps = <0x1e>;
				buswidth = <0x8>;
				regwidth = <0x10>;
				reset-gpios = <0xffffffff 0x19 0x1>;
				dc-gpios = <0xffffffff 0x18 0x0>;
				debug = <0x0>;
				init = <0x10000b0 0x0 0x1000011 0x20000ff 0x100003a 0x55 0x1000036 0x28 0x10000c2 0x44 0x10000c5 0x0 0x0 0x0 0x0 0x10000e0 0xf 0x1f 0x1c 0xc 0xf 0x8 0x48 0x98 0x37 0xa 0x13 0x4 0x11 0xd 0x0 0x10000e1 0xf 0x32 0x2e 0xb 0xd 0x5 0x47 0x75 0x37 0x6 0x10 0x3 0x24 0x20 0x0 0x10000e2 0xf 0x32 0x2e 0xb 0xd 0x5 0x47 0x75 0x37 0x6 0x10 0x3 0x24 0x20 0x0 0x1000036 0x28 0x1000011 0x1000029>;
				phandle = <0x2>;
			};

			waveshare35a-ts@1 {
				compatible = "ti,ads7846";
				reg = <0x1>;
				spi-max-frequency = <0x1e8480>;
				interrupts = <0x11 0x2>;
				interrupt-parent = <0xffffffff>;
				pendown-gpio = <0xffffffff 0x11 0x1>;
				ti,x-plate-ohms = [00 3c];
				ti,pressure-max = [00 ff];
				phandle = <0x3>;
			};
		};
	};

	__overrides__ {
		speed = <0x2 0x7370692d 0x6d61782d 0x66726571 0x75656e63 0x793a3000>;
		txbuflen = [00 00 00 02 74 78 62 75 66 6c 65 6e 3a 30 00];
		rotate = [00 00 00 02 72 6f 74 61 74 65 3a 30 00];
		fps = [00 00 00 02 66 70 73 3a 30 00];
		bgr = [00 00 00 02 62 67 72 3a 30 00];
		debug = <0x2 0x64656275 0x673a3000>;
		swapxy = <0x3 0x74692c73 0x7761702d 0x78793f00>;
	};

	__symbols__ {
		waveshare35a_pins = "/fragment@1/__overlay__/waveshare35a_pins";
		waveshare35a = "/fragment@2/__overlay__/waveshare35a@0";
		waveshare35a_ts = "/fragment@2/__overlay__/waveshare35a-ts@1";
	};

	__fixups__ {
		spi0 = "/fragment@0:target:0", "/fragment@2:target:0";
		gpio = "/fragment@1:target:0", "/fragment@2/__overlay__/waveshare35a@0:reset-gpios:0", "/fragment@2/__overlay__/waveshare35a@0:dc-gpios:0", "/fragment@2/__overlay__/waveshare35a-ts@1:interrupt-parent:0", "/fragment@2/__overlay__/waveshare35a-ts@1:pendown-gpio:0";
	};

	__local_fixups__ {

		fragment@2 {

			__overlay__ {

				waveshare35a@0 {
					pinctrl-0 = <0x0>;
				};
			};
		};

		__overrides__ {
			speed = <0x0>;
			txbuflen = <0x0>;
			rotate = <0x0>;
			fps = <0x0>;
			bgr = <0x0>;
			debug = <0x0>;
			swapxy = <0x0>;
		};
	};
};
